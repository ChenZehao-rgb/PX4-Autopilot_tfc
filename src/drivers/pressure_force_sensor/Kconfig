## src/drivers/pressure_force_sensor/Kconfig
```kconfig
menuconfig DRIVERS_PRESSURE_FORCE_SENSOR
	bool "pressure_force_sensor"
	default n
	---help---
		Enable support for pressure_force_sensor
```

## src/drivers/pressure_force_sensor_ref/Kconfig
```kconfig
menuconfig DRIVERS_PRESSURE_FORCE_SENSOR_REF
	bool "pressure_force_sensor_ref"
	default n
	---help---
		Enable support for pressure_force_sensor_ref
```

## src/drivers/rpm/as5600/Kconfig
```kconfig
menuconfig DRIVERS_RPM_AS5600
	bool "as5600"
	default n
	---help---
		Enable support for AS5600 I2C magnetic rotary position sensor
		for motor speed (RPM) measurement.
```
